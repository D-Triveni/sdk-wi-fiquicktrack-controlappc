## zephyr/Kconfig
```kconfig
#
# Copyright (c) 2023 Nordic Semiconductor
#
# SPDX-License-Identifier: LicenseRef-Nordic-5-Clause
#

config WFA_QT_CONTROL_APP
	# Need full POSIX from libc, Zephyr's POSIX support is only partial
	depends on !POSIX_API
	bool "WFA Quicktrack control app"
config WFA_QT_THREAD_STACK_SIZE
	int "Thread stack size"
	default 4096
	help
	  Thread stack size.

config WFA_QT_FEAT_WPS
       bool "WPS support"

config WFA_QT_FEAT_P2P
       bool "P2P feature support"
       depends on WFA_QT_FEAT_WPS

config WFA_QT_FEAT_HS20
       bool "HS 2.0 support"
	
```
